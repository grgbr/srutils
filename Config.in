## Config.in
```kconfig
################################################################################
# SPDX-License-Identifier: LGPL-3.0-only
#
# This file is part of srutils.
# Copyright (C) 2026 Grégor Boirie <gregor.boirie@free.fr>
################################################################################

mainmenu "Sysrepo / libyang utility libraries build configuration"

config TOPDIR
	string
	option env="TOPDIR"

menu "Sysrepo wrapper"

source "$TOPDIR/srepo/Config.in"

endmenu # "Sysrepo wrapper"

menu "Sysrepo plugin"

source "$TOPDIR/srplug/Config.in"

endmenu # "Sysrepo plugin"

# ex: ft=kconfig:
```

## srepo/Config.in
```kconfig
################################################################################
# SPDX-License-Identifier: LGPL-3.0-only
#
# This file is part of srutils.
# Copyright (C) 2026 Grégor Boirie <gregor.boirie@free.fr>
################################################################################

config SREPO_ASSERT
	bool "Assertion"
	default n
	help
	  Build srepo with assertions enabled to perform full verification of
	  arguments consistency as well as internal state.

config SREPO_DEBUG
	bool "Debug"
	default n
	help
	  Build srepo in debug mode, enabling additional debugging messages,
	  additional internal state consistency checks as well as full memory
	  cleanup logic suitable for memory error detection tools such as
	  Valgrind's Memcheck and co.

config SREPO_LOG
        bool "Logging"
        default y
        help
          Build srepo with support for logging messages through elog.

config SREPO_PRINT
        bool "Object printing"
        default n
        help
          Build srepo with support for displaying objects content on console.

# ex: ft=kconfig:
```
